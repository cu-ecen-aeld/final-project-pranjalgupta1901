## base_external/package/aesd_project/Config.in
```kconfig
config BR2_PACKAGE_AESD_PROJECT
	bool "aesd_project"
	help
	  Make and install utilities in the usr/bin	  
```

## base_external/package/lcd_display/Config.in
```kconfig
config BR2_PACKAGE_LCD_DISPLAY
	bool "lcd_display"
	help
	  Includes the support for lcd display	  
```
